#include "DxlMaster2.h"//подключение библиотеки
#define BAUDRATE 1000000//скорость сервоприводов
#define DEBUG_SERIAL Serial//установка последовательного интерфейса
#define jointN 6//количество сервоприводов
#define pages 17//количество положений, через которые проходит манипулятор
//указание необходимых переменных
int i = 0;
int j = 0;
const float DXL_PROTOCOL_VERSION = 1.0;//версия протокола, на которой работают сервоприводы
DynamixelMotor motors[] = {//массив сервоприводов с их id
DynamixelMotor(1), DynamixelMotor(2), DynamixelMotor(3), 
DynamixelMotor(4), DynamixelMotor(5), DynamixelMotor(6),
};
// массив со значениями стартовой позиции манипулятора
int start_pos [jointN+1]={2048, 2048, 2048, 1023, 511, 768,}; 
int buf[pages+1][jointN+1]={  
// инициализация двумерного массива с алгоритмом движения манипулятора
{1536, 2048, 2048, 1023, 384, 950, }, // перемещение
{1536, 1570, 2048, 1503, 384, 950, }, // опускание схвата
{1536, 1570, 2048, 1503, 384, 660, }, // захват объекта
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{2048, 2048, 2048, 1023, 511, 768, }, // стартовая позиция
};

void setup() { 
DxlMaster.begin(BAUDRATE);//скорость сервоприводов
Serial.begin(115200);//скорость передачи данных с компьютером
delay(3000);//задержка для установки скоростей
for (i=0; i<jointN; i++)  // цикл с изменением i от 0 до jointN с шагом 1 
motors[i].protocolVersion(DXL_PROTOCOL_VERSION);//установка протоколов
for (i=0; i<jointN; i++)  // цикл для перебора всех сервоприводов
{
motors[i].enableTorque();// управление крутящего момента 
motors[i].jointMode(0, 4095);//включение режима joint
motors[i].speed(27);//установка скорости
motors[i].goalPosition((uint32_t)start_pos[i]); // перемещение манипулятора в стартовую позицию
}
delay(5000);//задержка для установки параметров сервоприводов
}

//цикл для прохода всех сервоприводов по всем позициям, указанным в массиве
void loop() {
for (i=0; i<=pages; i++)//проходим по всем положениям
{
for(j=0; j<jointN; j++)//проходим по всем позициям
{
motors[j].goalPosition((uint32_t)buf[i][j]);//установка позиции
}
delay(5000);
}
}